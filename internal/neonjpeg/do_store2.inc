	// gas: st1     {v20.b}[4], [Y], #1
	// obj: st1     {v20.b}[4], [x9], #1
        WORD $0x0d9f1134
	// gas: st1     {v20.b}[5], [Y], #1
	// obj: st1     {v20.b}[5], [x9], #1
        WORD $0x0d9f1534
	// gas: st1     {v21.b}[4], [U], #1
	// obj: st1     {v21.b}[4], [x10], #1
        WORD $0x0d9f1155
	// gas: st1     {v21.b}[5], [U], #1
	// obj: st1     {v21.b}[5], [x10], #1
        WORD $0x0d9f1555
	// gas: st1     {v22.b}[4], [V], #1
	// obj: st1     {v22.b}[4], [x11], #1
        WORD $0x0d9f1176
	// gas: st1     {v22.b}[5], [V], #1
	// obj: st1     {v22.b}[5], [x11], #1
        WORD $0x0d9f1576
