	// gas: st1 {v20.b}[0], [Y], #1
        WORD $0x0d9f0134
	// gas: st1 {v20.b}[1], [Y], #1
	WORD $0x0d9f0534
	// gas: st1 {v20.b}[2], [Y], #1
        WORD $0x0d9f0934
	// gas: st1 {v20.b}[3], [Y], #1
        WORD $0x0d9f0d34
	// gas: st1 {v21.b}[0], [U], #1
        WORD $0x0d9f0155
	// gas: st1 {v21.b}[1], [U], #1
        WORD $0x0d9f0555
	// gas: st1 {v21.b}[2], [U], #1
        WORD $0x0d9f0955
	// gas: st1 {v21.b}[3], [U], #1
        WORD $0x0d9f0d55
	// gas: st1 {v22.b}[0], [V], #1
        WORD $0x0d9f0176
	// gas: st1 {v22.b}[1], [V], #1
        WORD $0x0d9f0576
	// gas: st1 {v22.b}[2], [V], #1
        WORD $0x0d9f0976
	// gas: st1 {v22.b}[3], [V], #1
        WORD $0x0d9f0d76
