	// gas: rshrn           v20.4h, v14.4s, #16
        WORD $0x0f108dd4
	// gas: shrn            v22.4h, v18.4s, #16
	WORD $0x0f108656
	// gas: shrn            v24.4h, v28.4s, #16
        WORD $0x0f108798
	// gas: rshrn2          v20.8h, v16.4s, #16
        WORD $0x4f108e14
	// gas: shrn2           v22.8h, v26.4s, #16
        WORD $0x4f108756
	// gas: shrn2           v24.8h, v30.4s, #16
        WORD $0x4f1087d8
	// gas: xtn             v20.8b, v20.8h       /* v20 = y */
        WORD $0x0e212a94
	// gas: xtn             v21.8b, v22.8h       /* v21 = u */
        WORD $0x0e212ad5
	// gas: xtn             v22.8b, v24.8h       /* v22 = v */
        WORD $0x0e212b16
